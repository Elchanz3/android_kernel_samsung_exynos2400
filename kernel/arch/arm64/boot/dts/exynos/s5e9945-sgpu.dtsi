/*
 * SAMSUNG SGPU device tree source
 *
 * Copyright (c) 2022 Samsung Electronics Co., Ltd.
 *		http://www.samsung.com
 *
 * This program is free software; you can redistribute it and/or modify
 * it under the terms of the GNU General Public License version 2 as
 * published by the Free Software Foundation.
 */

#include "s5e9945-sgpu_common.dtsi"

/{
	/* sgpu */
	sgpu: sgpu@22200000 {
		chip_revision = <0x02600200>;

		/* GPU DVFS */
		freq_table = <400000 600000 800000 1095000>;
		min_freq = <400000>;
		max_freq = <1095000>;
		min_threshold = "0 400000:60 600000:65 1095000:78";
		max_threshold = "75 600000:80 800000:85 1095000:95";
		downstay_time = "32 450000:64 500000:160";
		mif_min_lock = "400000:2730000 600000:3172000 800000:4206000 1095000:4206000";
		mif_cl_boost_min_lock = "400000:1352000 600000:1539000 800000:1716000 1095000:2028000";
		cl_boost_freq = <1095000>;
		mo_scenario = "default 450000:g3d_performance";
		llc_ways = "0 800000:16";
		highspeed_freq = <1095000>;
		highspeed_load = <56>;
		highspeed_delay = <0>;
		ifpo_disable_freq = <1095000>;

		/* IFPO */
		ifpo_type = <IFPO_ABORT>;
		ifpo_cal_id = <0x23>;
	};
};
